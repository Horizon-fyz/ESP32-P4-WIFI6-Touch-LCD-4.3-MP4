## main/Kconfig.projbuild
```kconfig
menu "阅读器配置"

    # esp_hosted 3.x 的组件清单里用到了这三个 Kconfig 变量（形如
    # `$CONFIG{...} == 1`），但它们只在 esp_hosted 自身的 Kconfig 中定义。
    # 在 ESP-IDF 5.5.4 下组件管理器解析清单时会因为找不到变量而反复重试。
    # 这里把它们补成 int 型（保持 0 = 关闭），即可正常解析清单。
    config ESP_HOSTED_HOST_USB_CDC_ACM_MANIFEST
        int "esp_hosted: USB CDC-ACM manifest (保持 0)"
        default 0

    config ESP_HOSTED_HOST_USB_CHERRYUSB_MANIFEST
        int "esp_hosted: CherryUSB manifest (保持 0)"
        default 0

    config ESP_HOSTED_HOST_USB_RNDIS_MANIFEST
        int "esp_hosted: USB RNDIS manifest (保持 0)"
        default 0

endmenu

menu "视频播放配置"

    # 官方 10_mp4_player 的 app_extractor.c 会读取这些符号
    config HDMI_VIDEO_SYNC_ENABLED
        bool "音视频同步"
        default y

    config AUDIO_DEC_FLAC_ENABLE
        bool "启用 FLAC 解码"
        default n

    config AUDIO_DEC_OPUS_ENABLE
        bool "启用 Opus 解码"
        default n

    config AUDIO_DEC_VORBIS_ENABLE
        bool "启用 Vorbis 解码"
        default n

    config AUDIO_DEC_ADPCM_ENABLE
        bool "启用 ADPCM 解码"
        default n

endmenu
```

## sdkconfig.defaults
```kconfig
CONFIG_IDF_TARGET="esp32p4"
# 本板为 ESP32-P4 Rev1.3，需使用 pre-v3 配置（200MHz PSRAM + legacy MIPI PHY 时钟）
CONFIG_ESP32P4_REV_MIN_100=y
# CONFIG_ESP32P4_REV_MIN_300 is not set
CONFIG_ESP32P4_SELECTS_REV_LESS_V3=y
CONFIG_BOOTLOADER_LOG_LEVEL_WARN=y
CONFIG_BOOTLOADER_LOG_LEVEL=2
CONFIG_ESPTOOLPY_FLASHMODE_QIO=y
CONFIG_ESPTOOLPY_FLASHSIZE_32MB=y
CONFIG_ESPTOOLPY_FLASHSIZE="32MB"
CONFIG_PARTITION_TABLE_CUSTOM=y
CONFIG_PARTITION_TABLE_CUSTOM_FILENAME="partitions.csv"
CONFIG_SPIRAM=y
CONFIG_SPIRAM_SPEED_200M=y
CONFIG_SPIRAM_XIP_FROM_PSRAM=y
CONFIG_CACHE_L2_CACHE_256KB=y
CONFIG_CACHE_L2_CACHE_LINE_128B=y
CONFIG_ESP_MAIN_TASK_STACK_SIZE=10240
CONFIG_FREERTOS_HZ=1000
CONFIG_COMPILER_OPTIMIZATION_PERF=y

# LVGL
CONFIG_LV_OS_FREERTOS=y
CONFIG_LV_USE_CLIB_MALLOC=y
CONFIG_LV_USE_CLIB_STRING=y
CONFIG_LV_USE_CLIB_SPRINTF=y
CONFIG_LV_DEF_REFR_PERIOD=15
CONFIG_LV_OBJ_STYLE_CACHE=y
CONFIG_LV_DRAW_SW_DRAW_UNIT_CNT=2
CONFIG_LV_USE_FONT_COMPRESSED=y
CONFIG_LV_USE_FONT_PLACEHOLDER=y
CONFIG_LV_FONT_MONTSERRAT_14=y
CONFIG_LV_FONT_MONTSERRAT_20=y
CONFIG_LV_FONT_MONTSERRAT_24=y
# 字体以 .bin 形式嵌入固件，用 LVGL 的内存文件系统解析
CONFIG_LV_USE_FS_MEMFS=y
CONFIG_LV_FS_MEMFS_LETTER=77
# 图片/视频缩略图直接用 LVGL 读取 SD 卡：S:/xxx.jpg -> /sdcard/xxx.jpg
CONFIG_LV_USE_FS_POSIX=y
CONFIG_LV_FS_POSIX_LETTER=83
CONFIG_LV_FS_POSIX_PATH="/sdcard"
# 全屏图片 480x800x2 = 750KB，缓存一帧避免每次重绘都重新解码
CONFIG_LV_CACHE_DEF_SIZE=1572864
# BMP 解码（LVGL 内置），PNG/JPEG/QOI 由 esp_lv_decoder 提供
CONFIG_LV_USE_BMP=y

# 蓝牙：P4 无射频，BLE 由板载 C6 通过 esp_hosted（VHCI）提供
CONFIG_BT_ENABLED=y
CONFIG_BT_NIMBLE_ENABLED=y
# NimBLE 默认走 UART HCI，本板必须关掉，改由 esp_hosted VHCI 传输
# CONFIG_BT_NIMBLE_TRANSPORT_UART is not set
CONFIG_ESP_HOSTED_ENABLE_BT_NIMBLE=y
CONFIG_BT_NIMBLE_MAX_CONNECTIONS=2

# 文件系统
CONFIG_FATFS_LFN_HEAP=y
CONFIG_FATFS_MAX_LFN=255
CONFIG_FATFS_API_ENCODING_UTF_8=y
CONFIG_SPI_FLASH_SUPPORT_GD_CHIP=y
```
